## projects/media_preview_example/cp/config/bk7259/defconfig
```kconfig
#
# H264E WiFi CP default config.
#
# CONFIG_BLUETOOTH is not set
# CONFIG_AT is not set
CONFIG_CONTROLLER_AP_BUFFER_COPY=y
CONFIG_PM_PROTECT_TIME_CHECK=y
CONFIG_FREERTOS_USE_TICKLESS_IDLE=2
CONFIG_WIFI_VNET_CONTROLLER=y
CONFIG_CONSOLE=y
# CONFIG_TEMP_DETECT is not set
# CONFIG_VOLT_DETECT is not set
CONFIG_DMA_LOGIC_CHAN_CNT=16
CONFIG_DMA_LOGIC_CHAN_ID_MIN=12
CONFIG_LV_FLASH_ENTER_LP_ENABLE=y
CONFIG_LP_VOL=0x6
CONFIG_PWM_V2P2=y
CONFIG_SOC_SMP=y
CONFIG_CPU_ID_OFFSET=0
CONFIG_SMP_CORE_CNT=2
# CONFIG_FREERTOS_V10 is not set
CONFIG_FREERTOS_SMP=y
CONFIG_FREERTOS_ALLOW_OS_API_IN_IRQ_DISABLED=y
CONFIG_SPINLOCK=y
```
