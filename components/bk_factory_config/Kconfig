## components/bk_factory_config/Kconfig
```kconfig
menu "BK Factory Config"
        config BK_FACTORY_CONFIG
        depends on EASY_FLASH
        bool "Enable BK factory config"
        default n
endmenu
```

## components/bk_key/Kconfig
```kconfig
# KCONFIG_GROUP: Device Drivers::Keys & Buttons
menu "BK Key (generic button engine)"

config BK_KEY
	bool "Enable generic key component (bk_key)"
	default n
	select BUTTON
	help
	  Decoupled button engine. Reuses the SDK multi_button / adc_key
	  drivers for detection and exposes device-agnostic (key_id, gesture)
	  events through a publish-subscribe API. The component has zero
	  business dependency: the mapping "which key does what" lives in the
	  product layer (e.g. projects/<name>/ap/key_map.c).

config BK_KEY_ADC
	bool "Enable ADC (resistor-divider) keys"
	depends on BK_KEY
	select ADC_KEY
	default n
	help
	  Route keys through the SDK adc_key resistor-ladder driver. Each key
	  is one voltage window on a shared ADC channel; bk_key registers one
	  detector item per window, so a single ADC line supports N keys
	  (not limited to the SDK S4/S5 naming).

config BK_KEY_ADC_CALIB
	bool "ADC key voltage calibration logging (TEMPORARY)"
	depends on BK_KEY_ADC
	default n
	help
	  Spawn a sampling thread that periodically reads the shared ADC channel
	  and prints the voltage whenever it changes. Use it once to read the
	  real per-key voltages (and the idle baseline), fill the adc_v_low/high
	  windows in the product key_map, then turn this OFF. Not for production.

config BK_KEY_MAX_LISTENERS
	int "Max subscribers"
	depends on BK_KEY
	default 4

config BK_KEY_THREAD_PRIO
	int "key dispatch thread priority"
	depends on BK_KEY
	default 4

config BK_KEY_THREAD_STACK
	int "key dispatch thread stack size (bytes)"
	depends on BK_KEY
	default 2048

endmenu
```

## components/boot_image_player/Kconfig
```kconfig
menu "Boot Image Player"

    config BOOT_IMAGE_PLAYER
        bool "Enable boot image player (boot splash image)"
        default n
        select BK_DECODER
        help
            Show a boot splash image (JPEG) once at power-up, read from VFS
            (/sd0 SD card or /if0 internal flash). The image is decoded by the
            hardware JPEG decoder (bk_decoder / vcdec) and flushed to the LCD
            once as raw NV12. No rotation/scaling is performed: author the boot
            image at the panel's native resolution and orientation.

            Independent from boot_video_player; the two are mutually exclusive
            at boot (the upper layer picks one).

    config BOOT_IMAGE_TASK_PRIORITY
        int "Boot image worker task priority"
        default 4
        depends on BOOT_IMAGE_PLAYER

    config BOOT_IMAGE_TASK_STACK_SIZE
        int "Boot image worker task stack size (bytes)"
        default 4096
        depends on BOOT_IMAGE_PLAYER

    config BOOT_IMAGE_SD_DISCHARGE_MS
        int "SD virtual re-plug discharge time (ms)"
        default 1500
        range 100 3000
        depends on BOOT_IMAGE_PLAYER
        help
            After disabling SDIO CLK/CMD/DAT0 pull-ups on cold boot, wait this
            long for the TF card to discharge below its POR threshold before
            restoring pull-ups and mounting. Same origin/experience value as
            boot_video_player (CONFIG_BOOT_VIDEO_SD_DISCHARGE_MS). On BK7259
            QFN128 EVB (SD always powered from VBAT), 1500 ms cold-boot verified.

endmenu
```

## components/boot_video_player/Kconfig
```kconfig
menu "Boot Video Player"

    config BOOT_VIDEO_PLAYER
        bool "Enable boot video player (boot animation)"
        default n
        select AVI_PLAYER
        select BK_VIDEO_PLAYER_ENABLE_AVI_PARSER
        select BK_VIDEO_PLAYER_ENABLE_HW_JPEG_VIDEO_DECODER
        help
            Play a boot animation video once at power-up, based on the
            bk_video_player engine. Enabling this auto-selects only the
            mandatory, low-footprint parts: the AVI parser and the HW JPEG
            decoder (AVI + MJPEG boot videos work out of the box).

            The MP4 container, H.264 video and AAC audio are optional and
            flash-heavy; the component code supports them, but they are only
            linked in when the corresponding engine options are enabled in the
            project defconfig (mind the app flash budget):
              CONFIG_BK_VIDEO_PLAYER_ENABLE_MP4_PARSER=y
              CONFIG_BK_VIDEO_PLAYER_ENABLE_HW_H264_VIDEO_DECODER=y
              CONFIG_BK_VIDEO_PLAYER_ENABLE_AAC_AUDIO_DECODER=y

    config BOOT_VIDEO_TASK_PRIORITY
        int "Boot video worker task priority"
        default 4
        depends on BOOT_VIDEO_PLAYER

    config BOOT_VIDEO_TASK_STACK_SIZE
        int "Boot video worker task stack size (bytes)"
        default 4096
        depends on BOOT_VIDEO_PLAYER

    config BOOT_VIDEO_PA_CTRL_ENABLE
        bool "Enable speaker PA control for boot video audio"
        default y
        depends on BOOT_VIDEO_PLAYER

    config BOOT_VIDEO_PA_CTRL_GPIO
        int "Speaker PA control GPIO"
        default 29
        depends on BOOT_VIDEO_PA_CTRL_ENABLE

    config BOOT_VIDEO_PA_ON_LEVEL
        int "Speaker PA active level (0/1)"
        default 1
        depends on BOOT_VIDEO_PA_CTRL_ENABLE

    config BOOT_VIDEO_SD_DISCHARGE_MS
        int "SD virtual re-plug discharge time (ms)"
        default 1500
        range 100 3000
        depends on BOOT_VIDEO_PLAYER
        help
            After disabling SDIO CLK/CMD/DAT0 pull-ups on cold boot, wait this
            long for the TF card to discharge below its POR threshold before
            restoring pull-ups and mounting. On BK7259 QFN128 EVB (SD always
            powered from VBAT), 250 ms and 800 ms were insufficient; 1500 ms
            cold-boot verified. Tune down gradually and cold-boot test after
            each change.

endmenu
```

## components/doorbell_common/Kconfig
```kconfig
menu "Doorbell Common"

    config INTEGRATION_DOORBELL
        bool "Doorbell integration"
        default n

    config INTEGRATION_DOORBELL_KVS
        bool "Doorbell + AWS KVS (no BLE provisioning; use bk_network_transfer kvs_service)"
        default n
        help
            Builds doorbell camera/media with kvs_service transport. Enable CONFIG_KVS_NTWK_BRIDGE
            and KVS/AWS options in the project defconfig.

    config DOORBELL_KEEPALIVE_ALWAYS_ON
        bool "Doorbell keep network service always online"
        default n
        depends on NTWK_CLIENT_SERVICE_ENABLE
        help
            Keep the doorbell network service online after multimedia services
            become idle. When disabled, the normal idle 10s AP power-down
            keepalive flow is used.

    choice H264_QP_PRESET
        prompt "H.264 bitrate/QP preset"
        default H264_QP_PRESET_DISABLED
        help
            Select one H.264 bitrate/QP preset.

        config H264_QP_PRESET_DISABLED
            bool "Disabled"

        config H264_QP_PRESET_QUALITY
            bool "Quality first: 2Mbps, I[20,40], P[24,40]"

        config H264_QP_PRESET_FIXED_QP
            bool "Fixed QP: bitrate off, I=21, P=26"

        config H264_QP_PRESET_BALANCED
            bool "Balanced: 1.5Mbps, I[22,42], P[26,44]"

        config H264_QP_PRESET_ANTI_STUTTER
            bool "Anti-stutter: 1.2Mbps, I[24,45], P[28,48]"

        config H264_QP_PRESET_LAN_HD
            bool "LAN HD: 3Mbps, I[18,36], P[22,38]"
    endchoice
endmenu
```

## components/doorbell_netcfg/Kconfig
```kconfig
menu "Doorbell Network Config"

	config DOORBELL_NETCFG
		bool "Enable doorbell WiFi provisioning + auto-reconnect (SDK bk_network_provisioning)"
		default n
		depends on BK_NETWORK_PROVISIONING && BK_BLE_PROVISIONING && EASY_FLASH
		help
		  Adapt the AI solution's provisioning scheme to the video_intercom
		  project: replace the legacy doorbell_boarding BLE transport with the
		  SDK bk_ble_provisioning GATT service, while keeping all doorbell
		  business (CS2 P2P, server-net-info, LAN UDP/TCP services) unchanged.

		  This component provides the doorbell_boarding.h symbols
		  (doorbell_boarding_init/event_notify*/operation_handle) backed by the
		  SDK transport, so doorbell_core.c is untouched and doorbell_boarding.c
		  is compiled out (guarded by !CONFIG_DOORBELL_NETCFG).

		  Default reconnect: on boot bk_network_provisioning_init(BLE) reconnects
		  from NV "d_network_id" when present (no advertising), otherwise starts
		  BLE provisioning. The SDK persists credentials on the first successful
		  GOT_IP4 so later boots reconnect automatically.

		  Only enable this in the video_intercom project; other doorbell projects
		  keep the legacy doorbell_boarding behavior.

endmenu
```

## components/multimedia_device_service/Kconfig
```kconfig
# KCONFIG_GROUP: Solution & Product
menu "Doorbell Service"
    config APP_USE_ISP_MP_CHANNEL
        depends on ISP
        bool "app layer open isp mp channel default"
        default y

    config MDS_SNAPSHOT
        bool "Enable snapshot capture module (JPEG HW/SW)"
        default n
        help
            Build snapshot capture into multimedia_device_service.
            Enable this option when snapshot CLI / doorbell capture is needed.
endmenu
```

## components/smart_intercom/Kconfig
```kconfig
menu "Video Intercom"

    config SMART_INTERCOM
        bool "Build the smart_intercom component (two-way video intercom)"
        default n
        help
            Enables the smart_intercom component sources.

    config SMART_INTERCOM_AUTO_TEST
        bool "Build the on-device self-loopback test harness (auto_test/)"
        depends on SMART_INTERCOM
        default n

    config SMART_INTERCOM_DL_ZEROCOPY
        bool "Downlink video zero-copy (reassemble directly into decode slots)"
        depends on SMART_INTERCOM
        default n

    choice
        prompt "Downlink video target resolution"
        depends on SMART_INTERCOM
        default SMART_INTERCOM_DL_RES_720P
        help
            Selects the downlink (App -> device) H.264 target resolution the
            solution is built for. The actual decode geometry is still negotiated
            at runtime via doorbell.imageStream.setReceiveConfig; this choice only
            drives (a) the resolution advertised in doorbell.solution.getConfig's
            default template and (b) the coded access-unit slot capacity so the
            selected resolution's key frames fit without being dropped.

            720p keeps the stock library behavior and memory footprint. 1080p
            raises the coded-AU cap for larger key frames and roughly doubles the
            H.264 decoder recon pool (PSRAM MEM_SLAB_HEAP_UNCODED); review the
            downlink slot count and PSRAM budget before shipping 1080p, especially
            with the uplink camera and PIP running concurrently.

        config SMART_INTERCOM_DL_RES_720P
            bool "720p (1280x720)"

        config SMART_INTERCOM_DL_RES_1080P
            bool "1080p (1920x1080)"
    endchoice

    config SMART_INTERCOM_DL_SLOT_COUNT
        int "Downlink decode ring slot count"
        depends on SMART_INTERCOM
        range 3 8
        default 4
        help
            Number of slots in the downlink H.264 decode ring. The ring absorbs
            the rate mismatch between network frame reception (producer) and
            hardware decode (consumer), most notably the ~54ms IDR decode stall
            during which several P frames keep arriving. Too small drops P frames
            in that window and breaks the reference chain; too large adds
            end-to-end latency and consumes more MEM_SLAB_HEAP_CODED (each slot
            is about W*H*3/2 bytes; at 1280x720 that is ~1.38MB per slot, so
            3 slots is a practical minimum). Empirically 4~5 is a good balance
            at sub-720p; use 3 for 720p downlink. Upper bound is 8 slots.

    config SMART_INTERCOM_DL_REQUEST_IDR
        bool "Downlink request-IDR-on-loss feedback (doorbell.notify.requestKeyFrame)"
        depends on SMART_INTERCOM
        default y
        help
            When the downlink H.264 decoder hits a broken reference (decode
            failure from a lost frame), the device sends the JSON-RPC
            notification doorbell.notify.requestKeyFrame to the App so it can
            force an immediate IDR and shorten recovery latency (WebRTC FIR/PLI
            style). The notification is rate-limited (>=300ms between sends) to
            avoid an IDR-request storm.

    config SMART_INTERCOM_DL_WAIT_IDR
        bool "Downlink drop-until-IDR error resilience"
        depends on SMART_INTERCOM
        default y
        help
            The downlink H.264 stream is IPPP with P frames chained to the
            previous frame (max_num_ref_frames=1), so a single lost frame breaks
            the reference chain and every following P decodes to garbage / a
            hardware error until the next IDR. When enabled, the decode task
            enters a "wait for IDR" state after any decode failure and cheaply
            discards non-IDR access units (recycling their slot) until an IDR
            resynchronizes the decoder, avoiding the broken-reference decode and
            error-dump storm. Disable to always feed every AU to the decoder.

endmenu
```

## components/smart_lock/Kconfig
```kconfig
menu "Smart Lock"

    config SMART_LOCK
        bool "Build the smart_lock component (legacy binary control-channel doorbell leaf)"
        depends on INTEGRATION_DOORBELL && !SMART_INTERCOM
        default y

endmenu
```

## projects/doorbell/ap/Kconfig.projbuild
```kconfig
menu "INTEGRATION_DOORBELL"

    config INTEGRATION_DOORBELL
        depends on VOICE_SERVICE && VOICE_READ_SERVICE && VOICE_WRITE_SERVICE
        bool "Doorbell integration"
        default n
    config INTEGRATION_DOORBELL_CS2
        bool "Doorbell integration CS2"
        default n
endmenu
```

## projects/doorbell_lp/cp/config/bk7259/defconfig
```kconfig
#
# Project default config for BK7259 doorbell_lp CP side.
# Based on BK7259 ap_powerdown_keepalive, with doorbell CP requirements retained.
#

CONFIG_CONTROLLER_AP_BUFFER_COPY=y

CONFIG_SOC_SMP=n
CONFIG_FREERTOS_V10=y
CONFIG_FREERTOS_SMP=n
#platform config
CONFIG_SLAVE_HEART_BEAT=n
CONFIG_MEMDUMP_ALL=y
CONFIG_PSRAM=y
CONFIG_PSRAM_AS_SYS_MEMORY=n
CONFIG_SPINLOCK_DYNAMIC_CNT=512
CONFIG_SPINLOCK_STATIC_CNT=128
CONFIG_AEC_RUN_ON_M52=n

#PM config
CONFIG_FREERTOS_USE_TICKLESS_IDLE=2
CONFIG_PM_AP_POWERDOWN_WHEN_LV=y
CONFIG_PM_ONLY_CP_ENABLE=y
CONFIG_DEEP_LV=y
CONFIG_DEEP_LV_DEBUG=y
CONFIG_AON_RTC=y
CONFIG_GPIO_WAKEUP_SUPPORT=y
CONFIG_GPIO_DYNAMIC_WAKEUP_SUPPORT=y

#wifi config
CONFIG_STA_PS=y

##CONFIG_EASY_FLASH=y
##CONFIG_EASY_FLASH_V4=y

#bluetooth config
CONFIG_BLUETOOTH_BLE_SLAVE_ONLY=y
CONFIG_BLUETOOTH_SUPPORT_LPO_ROSC=y
CONFIG_BLE_LV_SUPPORT=y

CONFIG_BTDM_CONTROLLER_ONLY=n
CONFIG_BLUETOOTH_SUPPORT_AP_PWD_ALL=y
```

## projects/ipc/cp/config/bk7259/defconfig
```kconfig
#
# Project default config for BK7259 ipc CP side.
# Based on doorbell_lp AP-powerdown keepalive, with ipc CP requirements retained.
#

CONFIG_CONTROLLER_AP_BUFFER_COPY=y

CONFIG_SOC_SMP=n
CONFIG_FREERTOS_V10=y
CONFIG_FREERTOS_SMP=n

# Platform config.
CONFIG_SLAVE_HEART_BEAT=n
CONFIG_DUMP_ENABLE=y
CONFIG_CP_HANG_DUMP_BY_AP=y
CONFIG_MEMDUMP_ALL=y
CONFIG_PSRAM=y
CONFIG_PSRAM_AS_SYS_MEMORY=n
CONFIG_HSPL_LEAK_DEBUG=y
CONFIG_SPINLOCK_DYNAMIC_CNT=512
CONFIG_SPINLOCK_STATIC_CNT=128
CONFIG_AEC_RUN_ON_M52=n

# PM config.
CONFIG_FREERTOS_USE_TICKLESS_IDLE=2
CONFIG_PM_AP_POWERDOWN_WHEN_LV=y
CONFIG_PM_ONLY_CP_ENABLE=y
CONFIG_DEEP_LV=y
CONFIG_DEEP_LV_DEBUG_GPIO=y
CONFIG_DEEP_LV_DEBUG_LOG=y
CONFIG_AON_LDO_SEL=2
CONFIG_AON_RTC=y
CONFIG_GPIO_WAKEUP_SUPPORT=y
CONFIG_GPIO_DYNAMIC_WAKEUP_SUPPORT=y

# Wi-Fi config.
CONFIG_STA_PS=y

# Bluetooth config.
CONFIG_BLUETOOTH_BLE_SLAVE_ONLY=y
CONFIG_BLUETOOTH_SUPPORT_LPO_ROSC=y
CONFIG_BLE_LV_SUPPORT=y
CONFIG_BTDM_CONTROLLER_ONLY=n
CONFIG_BLUETOOTH_SUPPORT_AP_PWD_ALL=y
```
