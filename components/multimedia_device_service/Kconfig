## components/multimedia_device_service/Kconfig
```kconfig
# KCONFIG_GROUP: Solution & Product
menu "Doorbell Service"
    config APP_USE_ISP_MP_CHANNEL
        depends on ISP
        bool "app layer open isp mp channel default"
        default y

    config MDS_SNAPSHOT
        bool "Enable snapshot capture module (JPEG HW/SW)"
        default n
        help
            Build snapshot capture into multimedia_device_service.
            Enable this option when snapshot CLI / doorbell capture is needed.

    config MDS_ENCODED_QUE_LEN
        int "Encoded image queue length (free/ready)"
        default 8
        range 3 16
        help
            Depth of the encoded image free/ready queues in mds_img_manager.
endmenu
```

## components/smart_intercom/Kconfig
```kconfig
menu "Video Intercom"

    config SMART_INTERCOM
        bool "Build the smart_intercom component (two-way video intercom)"
        default n
        help
            Enables the smart_intercom component sources.

    config DOOR_ACCESS_CALL_FLOW
        bool "Indoor-display incoming-call flow (ring / answer / hangup, full-screen remote)"
        depends on SMART_INTERCOM
        default n
        help
            Turns the smart_intercom two-way video path into an indoor-display
            call flow (projects/intercom_indoor_display). The App-facing protocol is UNCHANGED
            from video_intercom (same turnOn/turnOff request format, plain
            result/error replies); only the reply timing changes:

              - doorbell.videoIntercom.turnOn no longer starts media immediately
                and its reply is DEFERRED. It is treated as an *incoming-call
                invite* (ring): the device raises an INCOMING event to the local
                UI and waits. Media (uplink + downlink) starts only when the
                device user answers locally (touch / key), at which point the
                pending turnOn is answered with a success result. A local decline,
                a remote turnOff cancel, or a media start failure answers the
                pending turnOn with an error instead - so the App sees the call
                fail without any new message type.
              - The local user hangs up an active call (touch / key / on-video OSD
                button), which stops media (the turnOn was already answered).
              - The decoded remote picture is shown full-screen; the local
                camera self-view PIP small window is disabled (the local frame is
                still encoded and uplinked to the App, just not blitted locally).

            Leave this off for the stock video_intercom behavior (App-driven
            one-shot turnOn/turnOff with the PIP self-view overlay).

    config DOOR_ACCESS_CALL_LOCAL_UPLINK
        bool "Local camera uplink (capture + H.264 + send to App) during a two-way call"
        depends on DOOR_ACCESS_CALL_FLOW
        default n
        help
            When set, an answered indoor-display call opens the local camera
            uplink (capture + H.264 encode + video transfer to the App) in
            addition to the downlink, i.e. the App also sees the indoor unit.

            Left off (default) the answered call is downlink-only: the decoded
            remote picture is shown full-screen and NO local image is captured,
            encoded or sent to the App. The App-facing turnOn/turnOff protocol is
            unchanged; the "uplink" parameters are simply accepted and ignored.
            This is the usual indoor-monitor use case (watch the door camera
            without publishing the room), and it also frees the encoder /
            camera / GPU budget the uplink would otherwise consume.

            Only affects DOOR_ACCESS_CALL_FLOW; stock video_intercom always
            uplinks.

    config SMART_INTERCOM_DL_ZEROCOPY
        bool "Downlink video zero-copy (reassemble directly into decode slots)"
        depends on SMART_INTERCOM
        default n

    choice
        prompt "Downlink video target resolution"
        depends on SMART_INTERCOM
        default SMART_INTERCOM_DL_RES_720P
        help
            Selects the downlink (App -> device) H.264 target resolution the
            solution is built for. The actual decode geometry is still negotiated
            at runtime via doorbell.imageStream.setReceiveConfig; this choice only
            drives (a) the resolution advertised in doorbell.solution.getConfig's
            default template and (b) the coded access-unit slot capacity so the
            selected resolution's key frames fit without being dropped.

            720p keeps the stock library behavior and memory footprint. 1080p
            raises the coded-AU cap for larger key frames and roughly doubles the
            H.264 decoder recon pool (PSRAM MEM_SLAB_HEAP_UNCODED); review the
            downlink slot count and PSRAM budget before shipping 1080p, especially
            with the uplink camera and PIP running concurrently.

        config SMART_INTERCOM_DL_RES_720P
            bool "720p (1280x720)"

        config SMART_INTERCOM_DL_RES_1080P
            bool "1080p (1920x1080)"
    endchoice

    config SMART_INTERCOM_DL_SLOT_COUNT
        int "Downlink decode ring slot count"
        depends on SMART_INTERCOM
        range 3 8
        default 4
        help
            Number of slots in the downlink H.264 decode ring. The ring absorbs
            the rate mismatch between network frame reception (producer) and
            hardware decode (consumer), most notably the ~54ms IDR decode stall
            during which several P frames keep arriving. Too small drops P frames
            in that window and breaks the reference chain; too large adds
            end-to-end latency and consumes more MEM_SLAB_HEAP_CODED (each slot
            is about W*H*3/2 bytes; at 1280x720 that is ~1.38MB per slot, so
            3 slots is a practical minimum). Empirically 4~5 is a good balance
            at sub-720p; use 3 for 720p downlink. Upper bound is 8 slots.

    config SMART_INTERCOM_DL_REQUEST_IDR
        bool "Downlink request-IDR-on-loss feedback (doorbell.notify.requestKeyFrame)"
        depends on SMART_INTERCOM
        default y
        help
            When the downlink H.264 decoder hits a broken reference (decode
            failure from a lost frame), the device sends the JSON-RPC
            notification doorbell.notify.requestKeyFrame to the App so it can
            force an immediate IDR and shorten recovery latency (WebRTC FIR/PLI
            style). The notification is rate-limited (>=300ms between sends) to
            avoid an IDR-request storm.

    config SMART_INTERCOM_DL_WAIT_IDR
        bool "Downlink drop-until-IDR error resilience"
        depends on SMART_INTERCOM
        default y
        help
            The downlink H.264 stream is IPPP with P frames chained to the
            previous frame (max_num_ref_frames=1), so a single lost frame breaks
            the reference chain and every following P decodes to garbage / a
            hardware error until the next IDR. When enabled, the decode task
            enters a "wait for IDR" state after any decode failure and cheaply
            discards non-IDR access units (recycling their slot) until an IDR
            resynchronizes the decoder, avoiding the broken-reference decode and
            error-dump storm. Disable to always feed every AU to the decoder.

endmenu
```
